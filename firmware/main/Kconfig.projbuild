## firmware/main/Kconfig.projbuild
```kconfig
menu "VSense node configuration"

    config VSENSE_NODE_ID
        string "Node identifier"
        default "node_01"
        help
            Unique identifier used in logs, MQTT client identity, topics,
            and CSI payloads. Use values such as tx_01, rx_01, or rx_02.

    choice VSENSE_NODE_ROLE
        prompt "Node role"
        default VSENSE_NODE_ROLE_RX

        config VSENSE_NODE_ROLE_TX
            bool "TX"

        config VSENSE_NODE_ROLE_RX
            bool "RX"

        config VSENSE_NODE_ROLE_LD2450
            bool "LD2450 radar bridge"
    endchoice

    menu "Wi-Fi"
        config VSENSE_WIFI_SSID
            string "Wi-Fi SSID"
            default "change me"

        config VSENSE_WIFI_PASSWORD
            string "Wi-Fi password"
            default "change me"

        config VSENSE_WIFI_CHANNEL
            int "Wi-Fi channel"
            range 1 14
            default 6

        config VSENSE_WIFI_BSSID_LOCK_ENABLED
            bool "Lock connection to a specific access point BSSID"
            default n
            help
                Require this node to associate with one specific access point.
                This prevents nodes using the same SSID from roaming onto
                different radios or channels during CSI measurements.

        config VSENSE_WIFI_BSSID
            string "Access point BSSID"
            default "00:00:00:00:00:00"
            depends on VSENSE_WIFI_BSSID_LOCK_ENABLED
            help
                Access point MAC address in six-byte colon-separated
                hexadecimal form.
    endmenu

    menu "Packet generation"
        config VSENSE_PACKET_RATE_HZ
            int "TX packet rate (Hz)"
            range 1 1000
            default 100

        config VSENSE_RX_01_IP
            string "RX-01 target IPv4 address"
            default "192.168.128.35"

        config VSENSE_RX_02_ENABLED
            bool "Enable RX-02 target"
            default n
            help
                Send each TX packet to a second RX node. Keep this disabled
                until RX-02 has a verified or DHCP-reserved IPv4 address.

        config VSENSE_RX_02_IP
            string "RX-02 target IPv4 address"
            default "192.168.128.169"
            depends on VSENSE_RX_02_ENABLED

        config VSENSE_TX_TARGET_PORT
            int "RX target UDP port"
            range 1 65535
            default 3333
    endmenu

    menu "RX forwarding"
        config VSENSE_TX_MAC_FILTER_ENABLED
            bool "Filter CSI frames by TX MAC address"
            default n
            help
                Accept CSI frames only from the configured VSense TX node.
                Keep this disabled by default so a replaced or incorrectly
                configured TX cannot stop CSI collection without an explicit
                warning. Enable it for controlled sensing runs after verifying
                the TX station MAC.

        config VSENSE_TX_MAC
            string "Expected TX MAC address"
            default "84:fc:e6:5e:50:24"
            help
                Expected TX station MAC in six-byte colon-separated
                hexadecimal form. The value is retained even while filtering
                is disabled so it can be enabled without rebuilding the
                profile from scratch.

        config VSENSE_RX_UDP_PORT
            int "RX UDP listen port"
            range 1 65535
            default 3333

        config VSENSE_COLLECTOR_IP
            string "Collector IPv4 address"
            default "192.168.128.167"

        config VSENSE_COLLECTOR_UDP_PORT
            int "Collector UDP port"
            range 1 65535
            default 4444

        config VSENSE_MQTT_BROKER_URI
            string "MQTT broker URI"
            default "mqtt://192.168.128.167"

        config VSENSE_MQTT_KEEPALIVE_SECONDS
            int "MQTT keepalive interval (seconds)"
            range 15 60
            default 30
            help
                MQTT transport keepalive. Node liveness on the collector is
                detected independently from CSI/health traffic, so this value
                does not need to be shortened for five-second UI timeouts.

        config VSENSE_HEALTH_INTERVAL_MS
            int "Health telemetry interval (ms)"
            range 1000 60000
            default 5000

        config VSENSE_CSI_BUFFER_MAX_LEN
            int "Maximum CSI buffer length"
            range 64 384
            default 384
            help
                Maximum raw CSI bytes stored per frame. The upper bound keeps
                the JSON payload within the configured MQTT and UDP buffers.

        config VSENSE_CSI_LENGTH_FILTER_ENABLED
            bool "Filter CSI frames by expected length"
            default n
            help
                Accept only CSI frames whose raw byte length matches the
                configured value. Keep this disabled until the expected
                length has been measured for the active PHY/channel setup.

        config VSENSE_CSI_EXPECTED_LEN
            int "Expected CSI frame length"
            range 2 384
            default 256
            depends on VSENSE_CSI_LENGTH_FILTER_ENABLED
            help
                Expected raw CSI byte length for controlled sensing runs.
                This must be an even value no larger than the configured
                maximum CSI buffer length.

        config VSENSE_RAW_SEND_EVERY_N_FRAMES
            int "Forward every Nth accepted CSI frame"
            range 1 100
            default 1
            help
                Use 1 to forward every accepted CSI frame. Values greater than
                1 intentionally reduce the output sample rate and must be
                selected from measured queue/drop and synchronization results.
    endmenu

    menu "LD2450 radar bridge"
        depends on VSENSE_NODE_ROLE_LD2450

        config VSENSE_LD2450_UART_PORT
            int "UART controller number"
            range 1 2
            default 2

        config VSENSE_LD2450_UART_BAUD
            int "UART baud rate"
            range 9600 460800
            default 256000

        config VSENSE_LD2450_UART_AUTO_BAUD
            bool "Automatically detect a changed LD2450 baud rate"
            default y
            help
                Start with VSENSE_LD2450_UART_BAUD, then listen at every baud
                rate supported by the LD2450 until a valid target frame is
                received. This changes only the ESP UART rate; it does not
                write a persistent setting to the radar.

        config VSENSE_LD2450_UART_BAUD_SCAN_INTERVAL_MS
            int "Automatic baud scan dwell time (ms)"
            range 500 5000
            default 1500
            depends on VSENSE_LD2450_UART_AUTO_BAUD
            help
                Time spent listening at each baud rate before trying the next
                one. A powered LD2450 normally sends about ten frames per
                second, so 1500 ms leaves ample time to identify a frame.

        config VSENSE_LD2450_UART_RX_GPIO
            int "ESP32 GPIO receiving radar TX"
            range 0 48
            default 16

        config VSENSE_LD2450_UART_TX_GPIO
            int "ESP32 GPIO transmitting to radar RX"
            range 0 48
            default 17

        config VSENSE_LD2450_UART_RX_BUFFER_SIZE
            int "UART RX buffer size (bytes)"
            range 256 8192
            default 2048

        config VSENSE_LD2450_UART_EVENT_QUEUE_SIZE
            int "UART event queue length"
            range 4 64
            default 20

        config VSENSE_LD2450_FRAME_QUEUE_SIZE
            int "Parsed radar frame queue length"
            range 4 64
            default 16

        config VSENSE_LD2450_UART_READ_CHUNK_SIZE
            int "UART read chunk size (bytes)"
            range 32 512
            default 128

        config VSENSE_LD2450_TASK_STACK_SIZE
            int "Radar task stack size (bytes)"
            range 3072 8192
            default 4096

        config VSENSE_LD2450_TASK_PRIORITY
            int "Radar task priority"
            range 1 20
            default 5

        config VSENSE_LD2450_GROUND_TRUTH_TOPIC
            string "Ground-truth MQTT topic"
            default "vsense/gt/ld2450_01"
    endmenu

endmenu
```

## firmware/sdkconfig.defaults.ld2450_01
```kconfig
CONFIG_VSENSE_NODE_ID="ld2450_01"
CONFIG_VSENSE_NODE_ROLE_LD2450=y
CONFIG_VSENSE_WIFI_CHANNEL=1
# CONFIG_VSENSE_WIFI_BSSID_LOCK_ENABLED is not set
CONFIG_VSENSE_MQTT_BROKER_URI="mqtt://192.168.128.167"
CONFIG_VSENSE_LD2450_UART_PORT=2
CONFIG_VSENSE_LD2450_UART_BAUD=256000
# CONFIG_VSENSE_LD2450_UART_AUTO_BAUD is not set
CONFIG_VSENSE_LD2450_UART_BAUD_SCAN_INTERVAL_MS=1500
CONFIG_VSENSE_LD2450_UART_RX_GPIO=18
CONFIG_VSENSE_LD2450_UART_TX_GPIO=17
CONFIG_VSENSE_LD2450_UART_RX_BUFFER_SIZE=2048
CONFIG_VSENSE_LD2450_UART_EVENT_QUEUE_SIZE=20
CONFIG_VSENSE_LD2450_FRAME_QUEUE_SIZE=16
CONFIG_VSENSE_LD2450_UART_READ_CHUNK_SIZE=128
CONFIG_VSENSE_LD2450_TASK_STACK_SIZE=4096
CONFIG_VSENSE_LD2450_TASK_PRIORITY=5
CONFIG_VSENSE_LD2450_GROUND_TRUTH_TOPIC="vsense/gt/ld2450_01"
```

## firmware/sdkconfig.defaults.rx_01
```kconfig
CONFIG_VSENSE_NODE_ID="rx_01"
CONFIG_VSENSE_NODE_ROLE_RX=y
CONFIG_VSENSE_WIFI_CHANNEL=1
# CONFIG_VSENSE_WIFI_BSSID_LOCK_ENABLED is not set
CONFIG_VSENSE_TX_MAC_FILTER_ENABLED=y
CONFIG_VSENSE_TX_MAC="84:fc:e6:5e:50:24"
CONFIG_VSENSE_CSI_LENGTH_FILTER_ENABLED=y
CONFIG_VSENSE_CSI_EXPECTED_LEN=256
CONFIG_VSENSE_COLLECTOR_IP="192.168.128.167"
CONFIG_VSENSE_MQTT_BROKER_URI="mqtt://192.168.128.167"
```

## firmware/sdkconfig.defaults.rx_02
```kconfig
CONFIG_VSENSE_NODE_ID="rx_02"
CONFIG_VSENSE_NODE_ROLE_RX=y
# CONFIG_VSENSE_TX_MAC_FILTER_ENABLED is not set
CONFIG_VSENSE_TX_MAC="28:84:85:46:49:10"
CONFIG_VSENSE_COLLECTOR_IP="192.168.128.167"
CONFIG_VSENSE_MQTT_BROKER_URI="mqtt://192.168.128.167"
```

## firmware/sdkconfig.defaults.tx_01
```kconfig
CONFIG_VSENSE_NODE_ID="tx_01"
CONFIG_VSENSE_NODE_ROLE_TX=y
CONFIG_VSENSE_WIFI_CHANNEL=1
CONFIG_VSENSE_RX_01_IP="192.168.128.31"
CONFIG_VSENSE_RX_02_ENABLED=y
CONFIG_VSENSE_RX_02_IP="192.168.128.168"
```
